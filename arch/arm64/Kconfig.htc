## arch/arm64/Kconfig.htc
```kconfig
comment "HTC Debugging Features"
menuconfig HTC_DEBUG
	bool "HTC Debugging Feature Switch"
	default n
	help
	  Enable collection of debug features.
	  This feature is enabled in defconfig.

config LMK_ZYGOTE_PROTECT
	bool "LMK zygote protect"
	default n
	help
	  Say Y here if you want the HTC style for protecting zygote to be killed by LMK with invalid adj values

comment "HTC Projects"

menu "MSM Board Selection"

config MACH_OCE
  depends on ARCH_MSM8996
  bool "MSM8996SG OCE"
  help
    Support for HTC MSM8996 OCE

config MACH_AIO
  depends on ARCH_MSM8996
  bool "MSM8996SG AIO"
  help
    Support for HTC MSM8996 AIO

endmenu
```
